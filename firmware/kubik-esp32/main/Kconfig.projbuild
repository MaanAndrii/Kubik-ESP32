## firmware/kubik-esp32/main/Kconfig.projbuild
```kconfig
menu "Kubik companion"
config KUBIK_WIFI_SSID
    string "Wi-Fi SSID"
    default ""
config KUBIK_WIFI_PASSWORD
    string "Wi-Fi password"
    default ""
config KUBIK_DESKONE_URL
    string "DeskOne base URL (http://PC-IP:8765, no trailing slash)"
    default "http://192.168.1.100:8765"
config KUBIK_TOKEN
    string "DeskOne bridge token (24+ characters)"
    default ""
endmenu
```

## firmware/kubik-esp32/sdkconfig.defaults
```kconfig
CONFIG_ESPTOOLPY_FLASHMODE_QIO=y
CONFIG_ESPTOOLPY_FLASHSIZE_16MB=y
CONFIG_PARTITION_TABLE_CUSTOM=y
CONFIG_PARTITION_TABLE_CUSTOM_FILENAME="partitions.csv"
CONFIG_SPIRAM=y
CONFIG_SPIRAM_MODE_OCT=y
CONFIG_SPIRAM_SPEED_80M=y
CONFIG_ESP_DEFAULT_CPU_FREQ_MHZ_240=y
CONFIG_FREERTOS_HZ=1000
CONFIG_LV_OS_FREERTOS=y
CONFIG_LV_USE_CLIB_MALLOC=y
CONFIG_LV_USE_CLIB_STRING=y
CONFIG_LV_USE_CLIB_SPRINTF=y
CONFIG_LV_FONT_MONTSERRAT_24=y
```
